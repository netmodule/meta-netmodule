## conf/layer.conf
```bitbake
#@TYPE: Layer
#@NAME: meta-netmodule
#@DESCRIPTION: Netmodule Layer
#@AUTHOR: Stefan Eichenberger <stefan.eichenberger@netmodule.com>
#@HOMEPAGE = "http://www.netmodule.com"

# We have a conf and classes directory, add to BBPATH
BBPATH := "${LAYERDIR}:${BBPATH}"

# We have a packages directory, add to BBFILES
BBFILES := "${BBFILES} ${LAYERDIR}/recipes-*/*/*.bb \
            ${LAYERDIR}/recipes-*/*/*.bbappend"

BBFILE_COLLECTIONS += "netmodule"
BBFILE_PATTERN_netmodule := "^${LAYERDIR}/"
BBFILE_PRIORITY_netmodule = "7"
```

## conf/machine/zynq-ze7000.conf
```bitbake
#@TYPE: Machine
#@NAME: zynq-z4e
#@DESCRIPTION: poky image generated by NetModule AG (www.netmodule.com) for the ZE7000 (Z4E) Platform (http://www.netmodule.com/products/sbc-eval-sys/ZE7000.html)
#@AUTHOR: Stefan Eichenberger <stefan.eichenberger@netmodule.com>
#@HOMEPAGE = "http://www.netmodule.com"

MACHINE_FEATURES := ""
#IMAGE_FSTYPES and IMAGE_ROOTFS_SIZE are set in recipes-core/images/
#
#when we set limits, we really mean it
IMAGE_OVERHEAD_FACTOR := "1"
#QSPI flash has 64kB erase size
EXTRA_IMAGECMD_jffs2 = "-lnp -e64KiB"
# Don't include kernels in standard images
#RDEPENDS_kernel-base = ""

PREFERRED_PROVIDER_virtual/kernel ?= "linux-zynq"
PREFERRED_VERSION_linux-zynq ?= "3.5+xilinx-git"
#build the Qemu version coming from the Xilinx site
PREFERRED_VERSION_qemu-native ?= "xilinx"

require conf/machine/include/tune-cortexa9.inc

KERNEL_IMAGETYPE = "uImage"

SERIAL_CONSOLE = "115200 ttyPS0"
```

## conf/machine/zynq-zx3-pm3.conf
```bitbake
#@TYPE: Machine
#@NAME: zynq-zx3-pm3
#@DESCRIPTION: poky image generated by NetModule AG (www.netmodule.com) for the Mars ZX3 Module + Mars PM3 developement kit from Enclustra AG (http://www.enclustra.com/) 
#@AUTHOR: Stefan Eichenberger <stefan.eichenberger@netmodule.com>
#@HOMEPAGE = "http://www.netmodule.com"

MACHINE_FEATURES := ""
#IMAGE_FSTYPES and IMAGE_ROOTFS_SIZE are set in recipes-core/images/
#
#when we set limits, we really mean it
IMAGE_OVERHEAD_FACTOR := "1"
#QSPI flash has 64kB erase size
EXTRA_IMAGECMD_jffs2 = "-lnp -e64KiB"
# Don't include kernels in standard images
RDEPENDS_kernel-base = ""

PREFERRED_PROVIDER_virtual/kernel ?= "linux-zynq"
PREFERRED_VERSION_linux-zynq ?= "3.5+xilinx-git"
#build the Qemu version coming from the Xilinx site
PREFERRED_VERSION_qemu-native ?= "xilinx"
PREFERRED_VERSION_u-boot = "2012.04+xilinx-git"

require conf/machine/include/tune-cortexa9.inc

KERNEL_IMAGETYPE = "uImage"

SERIAL_CONSOLE = "115200 ttyPS0"
```
